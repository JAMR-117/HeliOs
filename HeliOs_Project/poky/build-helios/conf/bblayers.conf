## HeliOs_Project/poky/build-helios/conf/bblayers.conf
```bitbake
# POKY_BBLAYERS_CONF_VERSION is increased each time build/conf/bblayers.conf
# changes incompatibly
POKY_BBLAYERS_CONF_VERSION = "2"

BBPATH = "${TOPDIR}"
BBFILES ?= ""

BBLAYERS ?= " \
  /home/jm/HeliOs_Project/poky/meta \
  /home/jm/HeliOs_Project/poky/meta-poky \
  /home/jm/HeliOs_Project/poky/meta-yocto-bsp \
  /home/jm/HeliOs_Project/poky/meta-openembedded/meta-oe \
  /home/jm/HeliOs_Project/poky/meta-openembedded/meta-python \
  /home/jm/HeliOs_Project/poky/meta-openembedded/meta-networking \
  /home/jm/HeliOs_Project/poky/meta-raspberrypi \
  /home/jm/HeliOs_Project/poky/meta-helios \
  /home/jm/HeliOs_Project/poky/meta-flutter \
  "
```
